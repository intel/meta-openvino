## conf/layer.conf
```bitbake
# We have a conf and classes directory, add to BBPATH
BBPATH .= ":${LAYERDIR}"

# We have recipes-* directories, add to BBFILES
BBFILES += "${LAYERDIR}/recipes-*/*/*.bb \
            ${LAYERDIR}/recipes-*/*/*.bbappend"

BBFILE_COLLECTIONS += "openvino"
BBFILE_PATTERN_openvino := "^${LAYERDIR}/"
BBFILE_PRIORITY_openvino = "5"

LAYERDEPENDS_openvino = "core openembedded-layer meta-python"

# This should only be incremented on significant changes that will
# cause compatibility issues with other layers
LAYERVERSION_openvino = "5"
LAYERSERIES_COMPAT_openvino = "styhead walnascar"

require ${LAYERDIR}/conf/include/maintainers.inc

addpylib ${LAYERDIR}/lib oeqa
```
